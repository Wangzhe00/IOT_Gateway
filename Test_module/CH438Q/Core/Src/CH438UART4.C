/* 2011.8.26
****************************************
**  Copyright  (C)        1999-2011   **
**  Web:  http://www.winchiphead.com  **
****************************************
**  TC2.0@PC, KC7.0@MCS51             **
****************************************
*/

/*
********************************************** 
**
**  初始化CH438 串口4 
**
**********************************************
*/


#include  "include.h"

/*
  默认的外部时钟频率7.3728MHZ
*/
#define CH438UART4_BPS  9600             /* 定义CH438串口0通讯波特率 */
#define Fpclk           2666666          /* 定义内部时钟频率    */



/*********************************************************************************************************
** 函数名称: InitCH438UART4
** 功能描述: 主函数调用，用于初始化CH438串口4
** 输　入: 无
**
** 输　出: 无
**         
** 日　期: 2011年8月26日
**-------------------------------------------------------------------------------------------------------
** 修改人:
** 日　期:
**-------------------------------------------------------------------------------------------------------
********************************************************************************************************/

void InitCH438UART4( void )       
{
    UINT16 div;
    UINT8 DLL, DLM;
		UART4_Reset();
	  uDelay(50);
/**************************************************************************
          设置CH438串口4的寄存器
**************************************************************************/
//    UART4_Reset();
    div = ( Fpclk >> 4 ) / CH438UART4_BPS;
    DLM = div >> 8;
    DLL = div & 0xff;
    WriteCH438Data( REG_LCR4_ADDR, BIT_LCR_DLAB );    /* 设置DLAB为1 */
    WriteCH438Data( REG_DLL4_ADDR, DLL );             /* 设置波特率 */
    WriteCH438Data( REG_DLM4_ADDR, DLM );

    WriteCH438Data( REG_FCR4_ADDR, BIT_FCR_RECVTG1 | BIT_FCR_RECVTG0 | BIT_FCR_FIFOEN );    /* 设置FIFO模式，触发点为112字节 */

    WriteCH438Data( REG_LCR4_ADDR, BIT_LCR_WORDSZ1 | BIT_LCR_WORDSZ0 );                     /* 字长8位，1位停止位、无校验 */

    WriteCH438Data( REG_IER4_ADDR, /*BIT_IER_IEMODEM |*/ BIT_IER_IELINES | BIT_IER_IETHRE | BIT_IER_IERECV );    /* 使能中断 */

    WriteCH438Data( REG_MCR4_ADDR, BIT_MCR_OUT2    | BIT_MCR_RTS     | BIT_MCR_DTR );              /* 允许中断输出,DTR,RTS为1 */

    WriteCH438Data(REG_FCR4_ADDR,ReadCH438Data(REG_FCR4_ADDR)| BIT_FCR_TFIFORST|BIT_FCR_RFIFORST);

}



/*********************************************************************************************************
** 函数名称: UART4_Reset
** 功能描述: 功能函数，用于复位CH438串口4, 复位之后需要重新初始化串口 才可以正常使用
** 输　入: 无
**
** 输　出: 无
**         
** 日　期: 2011年8月26日
**-------------------------------------------------------------------------------------------------------
** 修改人:
** 日　期:
**-------------------------------------------------------------------------------------------------------
********************************************************************************************************/
void UART4_Reset( void )
{

    WriteCH438Data( REG_IER4_ADDR, BIT_IER_RESET ); 

}




/*********************************************************************************************************
** 函数名称: UART4_LowPower
** 功能描述: 功能函数，将CH438串口4进入低功耗模式
** 输　入: 无
**
** 输　出: 无
**         
** 日　期: 2011年8月26日
**-------------------------------------------------------------------------------------------------------
** 修改人:
** 日　期:
**-------------------------------------------------------------------------------------------------------
********************************************************************************************************/
void UART4_LowPower( void )
{

    WriteCH438Data( REG_IER4_ADDR, BIT_IER_LOWPOWER ); 

}




/*********************************************************************************************************
** 函数名称: UART4_SendByte
** 功能描述: 功能函数，用于CH438串口4 发送单个字节数据
** 输　入: 发送数据
**
** 输　出: 无
**
** 日　期: 2011年8月26日
**-------------------------------------------------------------------------------------------------------
** 修改人:
** 日　期:
**-------------------------------------------------------------------------------------------------------
********************************************************************************************************/
void UART4_SendByte( UINT8 dat )    
{

    while( ( ReadCH438Data( REG_LSR4_ADDR ) & BIT_LSR_THRE ) == 0 );    /* 等待数据发送完毕 */

    WriteCH438Data( REG_THR4_ADDR, dat );
}




/*********************************************************************************************************
** 函数名称: UART4_RcvByte
** 功能描述: 功能函数，用于CH438串口4 接收单个字节数据
** 输　入: 无
**
** 输　出: 接收数据
**
** 日　期: 2011年8月26日
**-------------------------------------------------------------------------------------------------------
** 修改人:
** 日　期:
**-------------------------------------------------------------------------------------------------------
********************************************************************************************************/
UINT8 UART4_RcvByte( void )    
{

    UINT8 Rcvdat;

    if( !( ReadCH438Data( REG_LSR4_ADDR ) & ( BIT_LSR_BREAKINT | BIT_LSR_FRAMEERR | BIT_LSR_PARERR | BIT_LSR_OVERR ) ) )    /*  b1-b4无错误 */
    {

        while( ( ReadCH438Data( REG_LSR4_ADDR ) & BIT_LSR_DATARDY ) == 0 );    /* 等待数据准备好 */

        Rcvdat = ReadCH438Data( REG_RBR4_ADDR );    /* 从接收缓冲寄存器读出数据 */

    }

    else ReadCH438Data( REG_RBR4_ADDR );    /* 有错误清除 */

        return( Rcvdat );
}





/*********************************************************************************************************
** 函数名称: UART4_SendStr
** 功能描述: 功能函数，用于CH438串口4 发送一个字符串
** 输　入: 字符串
**
** 输　出: 无
**
** 日　期: 2011年8月26日
**-------------------------------------------------------------------------------------------------------
** 修改人:
** 日　期:
**-------------------------------------------------------------------------------------------------------
********************************************************************************************************/
void UART4_SendStr( UINT8 *str )    
{

    while( 1 )
    {

        if( *str == '\0' ) break;

        UART4_SendByte( *str++ );

    }

}


/*********************************************************************************************************
** 函数名称: CH438Seril4Send
** 功能描述: 功能函数，禁用FIFO模式, 用于CH438串口4 发送多字节数据
** 输　入: 数据块
**
** 输　出: 无
**
** 日　期: 2011年8月26日
**-------------------------------------------------------------------------------------------------------
** 修改人:
** 日　期:
**-------------------------------------------------------------------------------------------------------
********************************************************************************************************/
void  CH438Seril4Send( UINT8 *Data, UINT8 Num )
{
    do
    {

        while( ( ReadCH438Data( REG_LSR4_ADDR ) & BIT_LSR_THRE ) == 0 );    /* 等待数据发送完毕 */

        WriteCH438Data( REG_THR4_ADDR, *Data++ );

    }

    while( --Num );

}



/*********************************************************************************************************
** 函数名称: CH438Seril4Rcv
** 功能描述: 功能函数，禁用FIFO模式, 用于CH438串口4 接收多字节数据
** 输　入: 接收数据缓冲区地址
**
** 输　出: 接收数据长度
**
** 日　期: 2011年8月26日
**-------------------------------------------------------------------------------------------------------
** 修改人:
** 日　期:
**-------------------------------------------------------------------------------------------------------
********************************************************************************************************/

UINT8  CH438Seril4Rcv( UINT8 *buf )
{
    UINT8 RcvNum = 0;

    if( !( ReadCH438Data( REG_LSR4_ADDR ) & ( BIT_LSR_BREAKINT | BIT_LSR_FRAMEERR | BIT_LSR_PARERR | BIT_LSR_OVERR ) ) )    /* b1-b4无错误 */
    {

        while( ( ReadCH438Data( REG_LSR4_ADDR ) & BIT_LSR_DATARDY ) == 0 );    /* 等待数据准备好 */

        do
        {

            *buf++ = ReadCH438Data( REG_RBR4_ADDR );                           /* 从接收缓冲寄存器读出数据 */

            RcvNum++;

        }

        while( ( ReadCH438Data( REG_LSR4_ADDR ) & BIT_LSR_DATARDY ) == 0x01 );
									   
    }

    else ReadCH438Data( REG_RBR4_ADDR );

    return( RcvNum );
}








/*********************************************************************************************************
** 函数名称: CH438UART4Send
** 功能描述: 功能函数，启用FIFO模式, 用于CH438串口4 发送多字节数据 单次最多发送128字节数据
** 输　入: 发送数据缓冲区地址, 发送数据块长度
**
** 输　出: 无
**
** 日　期: 2011年8月26日
**-------------------------------------------------------------------------------------------------------
** 修改人:
** 日　期:
**-------------------------------------------------------------------------------------------------------
********************************************************************************************************/
void  CH438UART4Send( UINT8 *Data, UINT8 Num )
{

    while( 1 )
    {

        while( ( ReadCH438Data( REG_LSR4_ADDR ) & BIT_LSR_TEMT ) == 0 );    /* 等待数据发送完毕，THR,TSR全空 */

        if( Num <= 128 )
        {

            WriteCH438Block( REG_THR4_ADDR, Num, Data );

            break;

        }

        else
        {

            WriteCH438Block( REG_THR4_ADDR, 128, Data );

            Num -= 128;

            Data += 128;

        }

    }
}



/*********************************************************************************************************
** 函数名称: Auto_HandFlow4_Ctrl
** 功能描述: 功能函数，串口4自动硬件流控制
** 输　入: 无
**
** 输　出: 无
**
** 日　期: 2011年8月26日
**-------------------------------------------------------------------------------------------------------
** 修改人:
** 日　期:
**-------------------------------------------------------------------------------------------------------
********************************************************************************************************/
void Auto_HandFlow4_Ctrl( void )
{

    WriteCH438Data( REG_MCR4_ADDR, BIT_MCR_AFE | BIT_MCR_OUT2 | BIT_MCR_RTS );    /* 设置MCR寄存器的AFE和RTS为1 */

}


